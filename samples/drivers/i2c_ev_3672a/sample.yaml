## samples/drivers/i2c_ev_3672a/sample.yaml
```yaml
sample:
  name: Demo for MEMSIC EV 3672A
tests:
  sample.drivers.i2c.ev_3672a:
    tags: drivers
    depends_on: i2c
    filter: dt_nodelabel_enabled("i2c0")
    harness: console
    harness_config:
        type: one_line
        regex:
            - "Data comparison successful."
        fixture: fixture_i2c_accelerometer
```
